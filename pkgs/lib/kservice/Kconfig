## pkgs/lib/l1/Kconfig
```kconfig
menuconfig PKG_USING_ECL
    bool "ecl l1: Implementation of L1 position control"
    select PKG_USING_MATRIX
    select PKG_USING_MATHLIB
    default n
```

## pkgs/lib/libcrc/Kconfig
```kconfig
menuconfig PKG_USING_LIBCRC
    bool "libcrc: cyclic redundancy check for crc8/16/32/64"
    default n
```

## pkgs/lib/matrix/Kconfig
```kconfig
menuconfig PKG_USING_MATRIX
	bool "matrix: A simple matrix template library"
	default n
```

## pkgs/lib/npfg/Kconfig
```kconfig
menuconfig PKG_USING_NPFG
    bool "npfg: Lateral-directional nonlinear path following guidance logic with excess wind handling"
    select PKG_USING_MATRIX

    default n
```

## pkgs/lib/param/Kconfig
```kconfig
menuconfig PKG_USING_PARAM
    bool "param: global parameter store manage"
    default n

if PKG_USING_PARAM
    choice
        prompt "Select Hrtimer Version"
        default PKG_USING_PARAM_V1

        config PKG_USING_PARAM_V1
            bool "PKG_USING_PARAM_V1"

        config PKG_USING_PARAM_V2
            bool "PKG_USING_PARAM_V2"

    endchoice

    if PKG_USING_PARAM_V1
        rsource "param_v1/Kconfig"
    endif

    if PKG_USING_PARAM_V2
        rsource "param_v2/Kconfig"
    endif

endif
```

## pkgs/lib/pid_design/Kconfig
```kconfig
menuconfig PKG_USING_PID_DESIGN
    bool "pid_design: Helper functions to design PID controllers using identified models"
    default n
```

## pkgs/lib/rate_control/Kconfig
```kconfig
menuconfig PKG_USING_RATE_CONTROL
    bool "rate_control: PID 3 axis angular rate / angular velocity control"
    default n
```

## pkgs/lib/scope/Kconfig
```kconfig
menuconfig PKG_USING_SCOPE
    bool "scope: a simple debug scope"
    default n


if PKG_USING_SCOPE
    config SCOPE_UART_NAME
        string "scope uart name"
        default "uart1"

    config SCOPE_UART_BAUDRATE
        int "scope uart baudrate"
        default 460800

    config ULOG_USING_SCOPE_BACKEND
        depends on RT_USING_ULOG
        bool "enable ulog scope backend"
        default n

    config SCOPE_USING_ASYNC_OUTPUT
        bool "scope using async output"
        default y

    config SCOPE_ASYNC_BUFFER_SIZE
        depends on SCOPE_USING_ASYNC_OUTPUT
        int "scope async buffer size"
        default 2048

    config SCOPE_ASYNC_THREAD_STACKSIZE
        depends on SCOPE_USING_ASYNC_OUTPUT
        int "scope async thread stack size"
        default 1024

    config SCOPE_ASYNC_THREAD_PRIORITY
        depends on SCOPE_USING_ASYNC_OUTPUT
        int "scope async thread priority"
        default 20

    config SCOPE_USING_INSIDE_CRC8
        bool "using CRC8 function inside scope"
        default y
endif
```

## pkgs/lib/shutdown/Kconfig
```kconfig
menuconfig PKG_USING_SHUTDOWN
    bool "shutdown: Power-related API"
    default n

if PKG_USING_SHUTDOWN

config BOARD_HAS_POWER_CONTROL
    bool "BOARD_HAS_POWER_CONTROL"
    default n

config CONFIG_BOARDCTL_RESET
    bool "CONFIG_BOARDCTL_RESET"
    default n

config CONFIG_BOARDCTL_POWEROFF
    bool "CONFIG_BOARDCTL_POWEROFF"
    default n

endif
```

## pkgs/lib/slew_rate/Kconfig
```kconfig
menuconfig PKG_USING_SLEW_RATE
    bool "slew_rate: limit the rate of change of a value with a maximum slew rate."
    select PKG_USING_MATRIX
    select PKG_USING_MATHLIB

    default n
```

## pkgs/lib/tecs/Kconfig
```kconfig
menuconfig PKG_USING_TECS
    bool "tecs: Total Energy Control System for fixed-wing"
    select PKG_USING_MATRIX
    select PKG_USING_MATHLIB
    select PKG_USING_GEO
    select PKG_UISNG_UORB
    select PKG_USING_MOTION_PLANNING

    default n
```

## pkgs/lib/variable_length_ringbuffer/Kconfig
```kconfig
menuconfig PKG_USING_VAR_LEN_RINGBUFFER
    bool "FIFO ringbuffer implementation for packets of variable length"
    select PKG_USING_RING_BUFFER
    default n
```

## pkgs/lib/weather_vane/Kconfig
```kconfig
menuconfig PKG_USING_WEATHER_VANE
    bool "weather_vane: Weathervane controller"
    select PKG_USING_MATRIX
    select PKG_USING_MATHLIB
    select PKG_USING_UORB

    default n
```

## pkgs/lib/wind_estimator/Kconfig
```kconfig
menuconfig PKG_USING_WIND_ESTIMATOR
    bool "wind estimaror: A wind and airspeed scale estimator"
    select PKG_USING_MATHLIB
    select PKG_USING_MATRIX
    select PKG_USING_HRTIMER
    default n

if PKG_USING_WIND_ESTIMATOR
endif
```

## pkgs/lib/work_queue_manager/Kconfig
```kconfig
menuconfig PKG_USING_WORKQUEUE
    bool "workq: a scheduled using workqueue"
    select PKG_USING_QUEUE
    select PKG_USING_HRTIMER
    select PKG_USING_CONTAINER

    default n
```

## pkgs/load_mon/Kconfig
```kconfig
menuconfig PKG_USING_LOAD_MONITOR
	bool "load_mon"
	default n
	---help---
		Enable support for load_mon
```

## pkgs/mathlib/Kconfig
```kconfig
menuconfig PKG_USING_MATHLIB
	bool "mathlib: collection of math functions"
	select PKG_USING_MATRIX
	default n
```

## pkgs/param/Kconfig
```kconfig
menuconfig SYS_USING_PARAM
    bool "param: global parameter store manage"
    select LIB_USING_LIBCRC
    select LIB_USING_HRTIMER
    default n

if SYS_USING_PARAM
    config PARAM_USING_GLOBAL_AUTOGEN
        bool "Enable autogen interface"
        default y

    config PARAM_USING_LINKER_SECTION
        bool "Enabel section interface"
        default n

    config PARAM_USING_SIMULINK_CAPI
        bool "Enable simulink interface"
        default n

    choice
        prompt "Select storage device"
        default PARAM_USING_STORAGE_FILE

        config PARAM_USING_STORAGE_FILE
            bool "file"

        config PARAM_USING_STORAGE_FM25V02
            bool "fm25v02"
    endchoice

    if PARAM_USING_STORAGE_FILE
        config PARAM_DEFAULT_FILE_PATH
            string "default file path for param"
            default "/mnt/microsd/etc/param.bin" if SYS_USING_ROMFS
            default "/param.bin"
    endif

    if PARAM_USING_STORAGE_FM25V02
        config PARAM_FM25V02_DEVICE_NAME
            string "fm25v02 device name for param"
            default "fm25v02"
    endif
endif
```

## pkgs/perf/Kconfig
```kconfig
menuconfig PKG_USING_PERF
    bool "perf: Performance measuring tools"
    default n
```

## pkgs/uORB/Kconfig
```kconfig
menuconfig PKG_USING_UORB
    bool "uORB: API for the uORB lightweight object broker"
    select PKG_USING_HRTIMER
    select PKG_USING_CONTAINER
    default n

if PKG_USING_UORB
    config UORB_USING_CALLBACK
        bool "enable uorb publish callback"
        default n
endif
```

## pkgs/ulog/Kconfig
```kconfig
menu "ULog backend"

config ULOG_BACKEND_USING_UORB
    bool "enable uORB backend for ulog"
    select PKG_USING_UORB
    default n

config ULOG_BACKEND_USING_FILES
    bool "enable files backend for ulog"
    select ULOG_BACKEND_USING_FILE
    default n

endmenu
```

## pkgs/ulog_backend/Kconfig
```kconfig
config ULOG_BACKEND_USING_UORB
    bool "enable uORB backend for ulog"
    select PKG_USING_UORB
    default n

config ULOG_BACKEND_USING_LOGGER
    bool "enable logger backend for ulog"
    select ULOG_BACKEND_USING_FILE
    default n
```

## pkgs/vconsole/Kconfig
```kconfig
menuconfig PKG_USING_VCONSOLE_V2
    bool "vconsole: A virtual console package."
    default n

# if PKG_USING_VCONSOLE_V2
#     config VCONSOLE_DEVICE_NAME
#         string "device name"
#         default "vconsole"

#     config VCONSOLE_RX_BUF_SIZE
#         int "rx buff size"
#         default 512

#     config VCONSOLE_TX_BUF_SIZE
#         int "tx buff size"
#         default 1024
# endif
```

## pkgs/workq/Kconfig
```kconfig
menuconfig PKG_USING_WORKQUEUE
    bool
    select PKG_USING_QUEUE
    select PKG_USING_HRTIMER
    select PKG_USING_CONTAINER

    default n
```
