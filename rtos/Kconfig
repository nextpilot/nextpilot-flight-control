## rtos/Kconfig
```kconfig
orsource "rt-thread/Kconfig"
orsource "packages/Kconfig"
orsource "platform/Kconfig"
```

## rtos/common/getopt/Kconfig
```kconfig
menuconfig PKG_USING_GETOPT
    bool "getopt: Minimal, thread safe version of getopt"
    default n
```

## rtos/common/queue/Kconfig
```kconfig
config PKG_USING_QUEUE
 bool "queue : single/double linked list based C language"
 default n
```

## utest/test_thread/Kconfig
```kconfig
menuconfig TEST_CREATE_THREAD
    bool "test create thread"
    default n

if TEST_CREATE_THREAD
endif
```

## utest/test_workq/Kconfig
```kconfig
menuconfig TEST_WORK_QUEUE
    bool "test work queue"
    default n

if TEST_WORK_QUEUE
endif
```
