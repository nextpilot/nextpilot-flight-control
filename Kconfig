## Kconfig
```kconfig
# 注意：请在bsps/*/*/（比如bsps/sitl/qemu）目录下面运行scons --menuconfig进行飞控配置，不要在当前目录运行menuconfig

orsource "*/Kconfig"
```

## apps/Kconfig
```kconfig
menu "Nextpilot Firmware Config"
config BOARD_CONSTRAINED_MEMORY
	bool
	default n if BSP_USING_QEMU
	default y

config BOARD_CONSTRAINED_FLASH
	bool
	default n if BSP_USING_QEMU
	default y

orsource "*/Kconfig"
endmenu
```

## apps/airframe/1102_sih_standard_vtol/Kconfig
```kconfig
menuconfig SYS_USING_1102_SIH_STANDARD_VTOL
    bool "1102_sih_standard_vtol"
    default n
```

## apps/airframe/1102_sih_tailsitter_duo/Kconfig
```kconfig
menuconfig SYS_USING_1102_TAILSITTER_DUO
    bool "1102_sih_tailsitter_duo"
    default n
```

## apps/airframe/1103_sih_standard_vtol/Kconfig
```kconfig
menuconfig SYS_USING_1103_SIH_STANDARD_VTOL
    bool "1103_sih_standard_vtol"
    default n
```

## apps/airframe/Kconfig
```kconfig
menu "Nextpilot Airframe Config"
menuconfig SYS_USING_AIRFRAME
    bool "airframe : reset params when change airframe"
    select SYS_USING_PARAM
    default n

if SYS_USING_AIRFRAME
    orsource "*/Kconfig"
endif

endmenu
```

## apps/controller/commander/Kconfig
```kconfig
menuconfig FCS_USING_COMMANDER
	bool "commander"
	select PKG_USING_SENSOR_CALIBRATION
	select PKG_USING_EVENTS
	select PKG_USING_TUNES
	select PKG_USING_WORLD_MAGNETIC_MODEL
	select PKG_USING_GETOPT
	default n
	---help---
		Enable support for commander

# menuconfig USER_COMMANDER
# 	bool "commander running as userspace module"
# 	default y
# 	depends on BOARD_PROTECTED && MODULES_COMMANDER
# 	---help---
# 		Put commander in userspace memory
```

## apps/controller/flight_mode_manager/Kconfig
```kconfig
menuconfig FCS_USING_FLIGHT_MODE_MANAGER
	bool "flight_mode_manager"
	select PKG_USING_MOTION_PLANNING
	select PKG_USING_SLEW_RATE
	select PKG_USING_WEATHER_VANE
	select PKG_USING_AVOIDANCE
	select PKG_USING_COLLISION_PREVENTION
	default n
	---help---
		Enable support for flight_mode_manager

# menuconfig USER_FLIGHT_MODE_MANAGER
# 	bool "flight_mode_manager running as userspace module"
# 	default y
# 	depends on BOARD_PROTECTED && MODULES_FLIGHT_MODE_MANAGER
# 	---help---
# 		Put flight_mode_manager in userspace memory
```

## apps/controller/fw_pos_control/Kconfig
```kconfig
menuconfig FCS_UISNG_FW_POS_CONTROL
	bool "fw_pos_control"
    select PKG_USING_NPFG
	select PKG_USING_TECS
	select PKG_USING_SLEW_RATE

	default n
	---help---
		Enable support for fw_pos_control

# menuconfig USER_FW_POS_CONTROL
# 	bool "fw_pos_control running as userspace module"
# 	default n
# 	depends on BOARD_PROTECTED && MODULES_FW_POS_CONTROL
# 	---help---
# 		Put fw_pos_control in userspace memory
```

## apps/controller/landing_target_estimator/Kconfig
```kconfig
menuconfig FCS_USING_LANDING_TARGET_ESTIMATOR
	bool "landing_target_estimator"
	default n
	---help---
		Enable support for landing_target_estimator

menuconfig USER_LANDING_TARGET_ESTIMATOR
	bool "landing_target_estimator running as userspace module"
	default y
	depends on BOARD_PROTECTED && FCS_USING_LANDING_TARGET_ESTIMATOR
	---help---
		Put landing_target_estimator in userspace memory
```

## apps/controller/manual_control/Kconfig
```kconfig
menuconfig FCS_USING_MANUAL_CONTROL
	bool "manual_control"
	default n
	---help---
		Enable support for manual_control
```

## apps/controller/mc_autotune_attitude_control/Kconfig
```kconfig
menuconfig FCS_MC_AUTOTUNE_ATTITUDE_CONTROL
	bool "mc_autotune_attitude_control"
	select PKG_USING_PID_DESIGN
	select PKG_USING_SYSTEM_IDENTIFICATION
	default n
	---help---
		Enable support for mc_autotune_attitude_control
```

## apps/controller/mc_rate_control/Kconfig
```kconfig
menuconfig FCS_USING_MC_RATE_CONTROL
	bool "mc_rate_control"
	select PKG_USING_UORB
	select PKG_USING_PARAM
	select PKG_USING_MATHLIB
	select LIB_USING_MAXTRIX
	default n
	---help---
		Enable support for mc_rate_control

# menuconfig USER_MC_RATE_CONTROL
# 	bool "mc_rate_control running as userspace module"
# 	default n
# 	depends on BOARD_PROTECTED && MODULES_MC_RATE_CONTROL
# 	---help---
# 		Put mc_rate_control in userspace memory
```

## apps/controller/navigator/Kconfig
```kconfig
menuconfig FCS_USING_NAVIGATOR
	bool "navigator"
	select SYS_USING_DATAMAN
	select PKG_USING_ADSB
	default n
	---help---
		Enable support for navigator

# menuconfig USER_NAVIGATOR
# 	bool "navigator running as userspace module"
# 	default y
# 	depends on BOARD_PROTECTED && MODULES_NAVIGATOR
# 	---help---
# 		Put navigator in userspace memory
```

## apps/estimator/airspeed_selector/Kconfig
```kconfig
menuconfig INS_USING_AIRSPEED_SELECTOR
	bool "airspeed_selector"
	select PKG_USING_WIND_ESTIMATOR
	default n
	---help---
		Enable support for airspeed_selector

# menuconfig USER_AIRSPEED_SELECTOR
# 	bool "airspeed_selector running as userspace module"
# 	default y
# 	depends on BOARD_PROTECTED && INS_USING_AIRSPEED_SELECTOR
# 	---help---
# 		Put airspeed_selector in userspace memory
```

## apps/estimator/ekf2_fake/Kconfig
```kconfig
menuconfig INS_USING_EKF2_FAKE
	bool "ekf2_fake"
	default n
	---help---
		Enable support for ekf2 fake
```

## apps/libraries/common/crclib/Kconfig
```kconfig
config LIB_USING_LIBCRC
    bool "crclib : cyclic redundancy check lib"
    default n
```

## apps/libraries/common/mathlib/Kconfig
```kconfig
menuconfig PKG_USING_MATHLIB
	bool "mathlib: collection of math functions"
	default n
```
