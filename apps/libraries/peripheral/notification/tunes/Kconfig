## apps/libraries/peripheral/notification/tunes/Kconfig
```kconfig
menuconfig PKG_USING_TUNES
    bool "tunes: Library for parsing tunes from melody-strings or dedicated tune messages"
    select PKG_USING_UORB
    select PKG_USING_CIRCUIT_BREAKER
    default n
```

## apps/libraries/peripheral/sensor/accelerometer/Kconfig
```kconfig
menuconfig PKG_USING_ACCELEROMETER
    bool "accelerometer"
    select PKG_USING_ROTATION
    default n
```

## apps/peripheral/actuator/pwm_out/Kconfig
```kconfig
menuconfig DRV_USING_PWM_OUT
	bool "pwm out"
	default n
	---help---
		Enable support for pwm_out
```

## apps/peripheral/battery/battery_status/Kconfig
```kconfig
menuconfig DRV_USING_BATTERY_STATUS
	bool "battery_status"
	select PKG_USING_BATTERY
	default n
	---help---
		Enable support for battery_status

if DRV_USING_BATTERY_STATUS
	config BOARD_NUMBER_BRICKS
		int "board number bricks"
		range 1 2
		default 1

    config ADC_BATTERY_DEVICE_NAME
        string "adc device name for battery monitor"
        default "adc1"

    if BOARD_NUMBER_BRICKS > 0
       config ADC_BATTERY1_VOLTAGE_CHANNEL
           int "battery 1 voltage adc channel"
           default 0

       config ADC_BATTERY1_CURRENT_CHANNEL
           int "battery 1 current adc channel"
           default 1

        # config BOARD_BATTERY1_V_DIV
        #     float "battery 1 voltage divider"
        #     default 21.0

        # config BOARD_BATTERY1_A_PER_V
        #     float "battery 1 current per voltage"
        #     default 36.367515152

    endif

    if BOARD_NUMBER_BRICKS > 1
       config ADC_BATTERY2_VOLTAGE_CHANNEL
           int "battery 2 voltage adc channel"
           default 2

       config ADC_BATTERY2_CURRENT_CHANNEL
           int "battery 2 current adc channel"
           default 3

        # config BOARD_BATTERY2_V_DIV
        #     float "battery 2 voltage divider"
        #     default 21.0

        # config BOARD_BATTERY2_A_PER_V
        #     float "battery 2 current per voltage"
        #     default 36.367515152
    endif
endif

# menuconfig USER_BATTERY_STATUS
# 	bool "battery_status running as userspace module"
# 	default n
# 	depends on BOARD_PROTECTED && MODULES_BATTERY_STATUS
# 	---help---
# 		Put battery_status in userspace memory
```

## apps/peripheral/notification/lights/rgbled_pwm/Kconfig
```kconfig
menuconfig DRV_USING_RGBLED_PWM
	bool "rgbled pwm"
	select PKG_USING_LED_CONTROL
	default n
	---help---
		Enable support for rgbled_pwm
```

## apps/peripheral/notification/lights/rgbled_tca62724/Kconfig
```kconfig
menuconfig DRV_USING_RGBLED_TCA62724
	bool "rgbled TCA62724FMG"
	default n
	---help---
		Enable support for rgbled
```

## apps/peripheral/notification/safety_button/Kconfig
```kconfig
menuconfig DRV_USING_SAFETY_BUTTON
	bool "safety_button"
    select PKG_USING_BUTTON_PUBLISHER
	default n
	---help---
		Enable support for safety_button

if DRV_USING_SAFETY_BUTTON
    comment "fast get pin number: (x - A) * 16 + n"
    config GPIO_SAFETY_SWITCH_IN
       int "safety button in pin (PE10=74)"
       default 74

    config GPIO_SAFETY_SWITCH_LED
        int "safety led out pin (PE12=76)"
        default 76

endif
```

## apps/peripheral/sensor/gnss/gps/Kconfig
```kconfig
menuconfig DRV_USING_GPS
	bool "gps driver for novatel, unicore, ublox etc"
	default n
	---help---
		Enable support for gps

if DRV_USING_GPS

	config DRV_USING_UNICORE
		bool "use unicore board"
		default n

	config DRV_USING_NOVATEL
		bool "use novatel board"
		default n

	config DRV_USING_UBX
		bool "use ubx board"
		default n
endif
```

## apps/peripheral/sensor/imu/bmi055/Kconfig
```kconfig
menuconfig DRV_USING_BOSCH_BMI055
	bool "bosch bmi055"
	select PKG_USING_GYROSCOPE
	select PKG_USING_ACCELEROMETER
	default n
	---help---
		Enable support for bosch bmi055
```

## apps/peripheral/sensor/imu/bmi088/Kconfig
```kconfig
menuconfig DRV_USING_BMI088
	bool "bosch bmi088"
	default n
	---help---
		Enable support for bosch bmi088
```
