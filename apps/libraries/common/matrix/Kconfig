## apps/libraries/common/matrix/Kconfig
```kconfig
menuconfig LIB_USING_MATHLIB
	bool "matrix: A simple matrix template library"
	default n
```

## apps/libraries/common/ringbuffer/Kconfig
```kconfig
menuconfig PKG_USING_RING_BUFFER
	bool "ring_buffer: FIFO ringbuffer implementation"
	default n
```

## apps/libraries/controller/adsb/Kconfig
```kconfig
menuconfig PKG_USING_ADSB
    bool "ads-b: ADS-B Conflict"
    select PKG_USING_MATRIX
    select PKG_USING_MATHLIB
    select PKG_USING_UORB

    default n
```

## apps/libraries/controller/avoidance/Kconfig
```kconfig
menuconfig PKG_USING_AVOIDANCE
    bool "avoidance: inject the setpoints of an obstacle avoidance system"
    select PKG_USING_MATRIX
    select PKG_USING_MATHLIB
    select PKUG_USING_UORB

    default n
```

## apps/libraries/controller/controllib/Kconfig
```kconfig
menuconfig PKG_USING_CONTROLLIB
    bool "controllib: geo / math functions to perform geodesic calculations"
    select PKG_USING_MATRIX
    select PKG_USING_MATHLIB
    select PKG_USING_HRTIMER
    default n
```

## apps/libraries/controller/conversion/Kconfig
```kconfig
menuconfig PKG_USING_ROTATION
    bool "rotation: a Vector rotation library"
    select PKG_USING_MATRIX
    default n
```

## apps/libraries/controller/hysteresis/Kconfig
```kconfig
menuconfig PKG_USING_HYSTERESIS
    bool "Hysteresis: Hysteresis of a boolean value"
    select PKG_USING_HRTIMER
    default n
```

## apps/libraries/controller/mixer_module/Kconfig
```kconfig
menuconfig PKG_USING_MIXER_MODULE
    bool "mixer_module: class for an output module"
    select PKG_USING_UORB
    select PKG_USING_PARAM
    select PKG_USING_MODULE
    select PKG_USING_PERF
    select PKG_USING_MATHLIB
    default n
```

## apps/libraries/controller/motion_planning/Kconfig
```kconfig
menuconfig PKG_USING_MOTION_PLANNING
    bool "motion_planning: generates setpoints for a smooth trajectory to position waypoints"
    select PKG_USING_MATRIX

    default n
```

## apps/libraries/controller/npfg/Kconfig
```kconfig
menuconfig PKG_USING_BEZIER
    bool "bezier: N-order Bezier library designed for time-aware trajectory tracking"
    select PKG_USING_MATRIX

    default n
```

## apps/libraries/controller/pid/Kconfig
```kconfig
menuconfig PKG_USING_PID
    bool "pid: Definition of generic PID controller"
    default n
```

## apps/libraries/controller/system_identification/Kconfig
```kconfig
menuconfig PKG_USING_SYSTEM_IDENTIFICATION
    bool "system_identification"
    select PKG_USING_MATRIX
    select PKG_USING_MATHLIB

    default n
```

## apps/libraries/controller/tecs/Kconfig
```kconfig
menuconfig PKG_USING_TECS
    bool "tecs: Total Energy Control System for fixed-wing"
    select PKG_USING_MATRIX
    select PKG_USING_GEO

    default n
```

## apps/libraries/controller/terrain_estimation/Kconfig
```kconfig
menuconfig PKG_USING_TERRAIN_ESTIMATION
    bool "terrain_estimation: A terrain estimation kalman filter"
    select PKG_USING_MATRIX
    select PKG_USING_MATHLIB

    default n
```

## apps/libraries/estimator/field_sensor_bias_estimator/Kconfig
```kconfig
menuconfig PKG_USING_FIELD_SENSOR_BIAS_ESTIMATOR
    bool "Estimator for the magnetometer/accelerometer bias calibration parameters to run online with the help of Gyroscope data"
    default n
```

## apps/libraries/estimator/sensor_calibration/Kconfig
```kconfig
menuconfig PKG_USING_SENSOR_CALIBRATION
    bool "sensor_calibration"
    select PKG_USING_MATRIX
    select PKG_USING_MATHLIB
    select PKUG_USING_UORB

    default n
```

## apps/libraries/estimator/terrain_estimation/Kconfig
```kconfig
menuconfig PKG_USING_TERRAIN_ESTIMATOR
    bool "estimate distance to the ground using a laser range finder"
    default n
```

## apps/libraries/estimator/world_magnetic_model/Kconfig
```kconfig
menuconfig PKG_USING_WORLD_MAGNETIC_MODEL
    bool "world_magnetic_model"
    default n
```

## apps/libraries/peripheral/notification/led/Kconfig
```kconfig
menuconfig PKG_USING_LED_CONTROL
    bool "led_control: Led controller helper class, used by Led drivers"
    default n
```
