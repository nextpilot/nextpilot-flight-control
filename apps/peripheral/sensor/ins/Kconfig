## apps/peripheral/sensor/ins/pa_gs02b/Kconfig
```kconfig
menuconfig DRV_USING_PA_GS02B
   bool "pa_gs02b: High Precision INS data from JingZhunCeKong.,LTD"
   default n

if DRV_USING_PA_GS02B

   config PA_GS02B_UART_DEVICE
      string "uart device name for pa-gs02b"
      default "uart4"

   config PA_GS02B_UART_BAUDRATE
      int "uart baudrate for pa-gs02b"
      default 115200

endif
```

## apps/simulation/battery_simulator/Kconfig
```kconfig
menuconfig SIM_USING_BATTERY
	bool "battery_simulator"
	select PKG_USING_BATTERY
	default n
	---help---
		Enable support for battery_simulator
```

## apps/simulation/pwm_out_sim/Kconfig
```kconfig
menuconfig SIM_USING_PWM_OUT
	bool "pwm_out_sim"
	select PKG_USING_MIXER_MODULE
	default n
	---help---
		Enable support for pwm_out_sim
```

## apps/simulation/sensor_airspeed_sim/Kconfig
```kconfig
menuconfig SIM_USING_SENSOR_AIRSPEED
	bool "sensor_airspeed_sim"
	select PKG_USING_AIRSPEED
	default n
	---help---
		Enable support for sensor_airspeed_sim
```

## apps/simulation/sensor_baro_sim/Kconfig
```kconfig
menuconfig SIM_USING_SENSOR_BARO
	bool "sensor_baro_sim"
	select PKG_USING_BARO
	default n
	---help---
		Enable support for sensor_baro_sim
```

## apps/simulation/sensor_gps_sim/Kconfig
```kconfig
menuconfig SIM_USING_SENSOR_GPS
	bool "sensor_gps_sim"
	default n
	---help---
		Enable support for sensor_gps_sim
```

## apps/simulation/sensor_mag_sim/Kconfig
```kconfig
menuconfig SIM_USING_SENSOR_MAG
	bool "sensor_mag_sim"
	select PKG_USING_WORLD_MAGNETIC_MODEL
	select 	PKG_USING_MAGNETOMETER
	default n
	---help---
		Enable support for sensor_mag_sim
```

## apps/simulation/simulator_mavlink/Kconfig
```kconfig
menuconfig MODULES_SIMULATION_SIMULATOR_MAVLINK
	bool "simulator_mavlink"
	default n
	select SIM_USING_PWM_OUT
	depends on PLATFORM_POSIX
	---help---
		Enable support for mavlink simulator
```

## apps/simulation/simulator_sih/Kconfig
```kconfig
menuconfig SIM_USING_SIH
	bool "simulator_sih"
	default n
	select SIM_USING_PWM_OUT
	select SIM_USING_SENSOR_BARO
	select SIM_USING_SENSOR_GPS
	select SIM_USING_SENSOR_MAG
	select PKG_USING_ACCELEROMETER
	select PKG_USING_GYROSCOPE
	---help---
		Enable support for simulator_sih

# menuconfig USER_SIH
# 	bool "simulator_sih running as userspace module"
# 	default y
# 	depends on BOARD_PROTECTED && SIM_USING_SIH
# 	---help---
# 		Put sih in userspace memory
```

## apps/storage/dataman/Kconfig
```kconfig
menuconfig SYS_USING_DATAMAN
    bool "dataman : geofense, mission data manage"
    select PKG_USING_PERF
    default n

if SYS_USING_DATAMAN
    config DATAMAN_DEFAULT_FILE_PATH
        string "dataman save path"
        # default "/mnt/norflash/dataman.bin" if RT_USING_QSPI
        default "/mnt/microsd/etc/dataman.bin" if SYS_USING_ROMFS
        default "/dataman.bin"

endif
```

## apps/storage/logger/Kconfig
```kconfig
menuconfig SYS_USING_LOGGER
    bool "logger : save uorb and ulog message to file"
    select PKG_USING_SHUTDOWN
    select PKG_USING_CPULOAD
    default n

if SYS_USING_LOGGER

    config LOGGER_FULL_LOG_ROOT_PATH
        string "full size log root path"
        default "/mnt/microsd/log" if SYS_USING_ROMFS
        default "/log"

    config LOGGER_LESS_LOG_ROOT_PATH
        string "reduced mission log root path"
        default "/mnt/micorsd/mission_log"  if SYS_USING_ROMFS
        default "/mission_log"

endif
```

## apps/storage/romfs/Kconfig
```kconfig
config SYS_USING_ROMFS
    bool "romfs : enable chip flash file system"
    select RT_USING_DFS_ROMFS
    default n

if SYS_USING_ROMFS

endif
```

## apps/telemetry/mavlink/Kconfig
```kconfig
menuconfig TEL_USING_MAVLINK
	bool "mavlink"
	select PKG_USING_VAR_LEN_RINGBUFFER
	select PKG_USING_UORB
	select PKG_USING_PARAM
	select PKG_USING_BOARD_VERSION
	select PKG_USING_ACCELEROMETER
	select PKG_USING_GYROSCOPE
	select PKG_USING_MAGNETOMETER
	select PKG_USING_GEO
	select PKG_USING_SENSOR_CALIBRATION
	default n
	---help---
		Enable support for mavlink

if TEL_USING_MAVLINK
	config MAVLINK_DIALECT
		string "Mavlink dialect"
		default "common"
		---help---
			Select the Mavlink dialect to generate and use.

	# config MAVLINK_USING_UDP
	# 	bool "support udp connection"
	# 	select SAL_USING_POSIX
	# 	default y if BSP_USING_QEMU
	# 	default n

	# config MAVLINK_COMM_NUM_BUFFERS
	# 	int "mavlink max instance"
	# 	range 1 6
	# 	default 6 if MAVLINK_USING_UDP
	# 	default 4

	config MAVLINK_USING_PARAM
        bool "enable parameter service"
		default n

	config MAVLINK_USING_UAVCAN_PARAM
		depends on TEL_USING_UAVCAN && MAVLINK_USING_PARAM
		bool "enable UAVCAN parameter support"
		default y
		---help---
			Expose UAVCAN parameters over Mavlink.

	config MAVLINK_USING_MISSION
        bool "enable mission service"
		default n

    config MAVLINK_USING_FTP
        bool "enable ftp service"
        default n

	config MALVINK_FTP_ROOT_DIR
        string "ftp root dir"
        default "/mnt/microsd" if SYS_USING_ROMFS
        default "/"
        depends on MAVLINK_USING_FTP

	config MAVLINK_USING_SHELL
		bool "enable mavlink shell service"
		select PKG_USING_VCONSOLE_V2
		default n

    config MAVLINK_USING_LOG_DOWNLOAD
        bool "enable log download service"
        default n

    config MALVINK_LOG_ROOT_DIR
        string "log root dir"
        default "/mnt/microsd/log" if SYS_USING_ROMFS
        default "/log"
        depends on MAVLINK_USING_LOG_DOWNLOAD

    config MAVLINK_USING_LOG_STREAM
        bool "enable log stream"
        default n

    config MAVLINK_USING_TIMESYNC
        bool "enable timesync service"
        default n

    config MAVLINK_USING_PLAY_TUNE
        bool "enable tune publisher"
        default n
endif
```

## apps/universal/hrtimer/new/Kconfig
```kconfig
menuconfig SYS_USING_HRTIMER
    bool "hrtimer: high-resolution timer with callouts and timekeeping"
    select LIB_USING_QUEUE
    default n

if SYS_USING_HRTIMER
    choice
        default HRT_USING_HARD_SYSTICK
        prompt "Select hrtimer source"

        config HRT_USING_HARD_SYSTICK
            bool "os systick"

        config HRT_USING_HARD_TIMER
            bool "hard timer"

    endchoice

    if HRT_USING_HARD_TIMER
        config HRT_HARD_TIMER_NAME
            string "hard timer name"
            default "tim13"
    endif

endif
```

## apps/universal/hrtimer/old/Kconfig
```kconfig
config LIB_USING_HRTIMER
    bool "hrtimer : high-resolution timer with callouts and timekeeping"
    select LIB_USING_QUEUE
    default n

if LIB_USING_HRTIMER
config HRT_USING_CALLOUT
    bool "Callout function"
    default n
endif
```

## apps/universal/version/Kconfig
```kconfig
menuconfig SYS_USING_VERSION
    bool "version : hardware and software version manage"
    default n

if SYS_USING_VERSION
    config BOARD_TYPE_NAME
        string "board name"
        default "unkown"

    config BOARD_CHIP_NAME
        string "chip name"
        default "unkown"

    config BOARD_HAS_HW_VERSIONING
        bool "board has hw version"
        default n

    if BOARD_HAS_HW_VERSIONING
        config ADC_HW_VER_DEVICE_NAME
            string "adc device name"
            default "adc1"

        config ADC_HW_VER_SENSE_CHANNEL
            int "version sense adc channel"
            default 12

        config GPIO_HW_VER_DRIVE
            int "version drive pin (PH14=126)"
            default 126

        config ADC_HW_REV_SENSE_CHANNEL
            int "revision sense adc channel"
            default 13

        config GPIO_HW_REV_DRIVE
            int "revision drive pin (PH14=126)"
            default 126
    endif

endif
```
