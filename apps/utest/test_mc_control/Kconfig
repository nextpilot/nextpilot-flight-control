## bsps/px4/fmu-v6xrt/Kconfig
```kconfig
mainmenu "RT-Thread Configuration"

# 1. 变量立即赋值，简单展开，立即求值
# RTT_DIR  := ../../../rtos/rt-thread
# PKGS_DIR := ../../../rtos/packages
#
# 2. 变量延迟赋值，使用的时候才展开
# CC = $(CROSS_TOOL)gcc
#
# 3. 追加赋值
# VAR += ADDITIONAL
#
# 4. 变量引用，含环境变量，采用$(VAR)
# rsource "$(RTT_DIR)/Kconfig"
# osource "$(PKGS_DIR)/Kconfig"
#
# 5. 引用环境变量
#  $(VAR)   可以引用变量和环境变量，优先使用Kconfig中变量，没有则在环境变量中搜索，可以用于所有语句
#  $ENV_VAR 只能引用环境变量，直接在环境变量中搜索，且只能用于source命令
#
# 6. 内置函数
# $(shell, command)  执行shell命令
# $(info, text)      打印信息
# $(warning-if, condition, text)
# $(error-if, condition, text)
# $(filename)         当前文件名
# $(lineno)           当前行号


RTT_DIR := ../../../rtos/rt-thread
PKGS_DIR := ../../../rtos/packages

rsource "$(RTT_DIR)/Kconfig"
#osource "$(PKGS_DIR)/Kconfig"
rsource "board/Kconfig"
```

## bsps/sitl/qemu/Kconfig
```kconfig
mainmenu "Nexpilot Project Configuration"

config BSP_DIR
    string
    option env="BSP_ROOT"
    default "."

config PRJ_DIR
    string
    option env="PRJ_ROOT"
    default "../../.."

config RTT_DIR
    string
    option env="RTT_ROOT"
    default "../../../rtos/rt-thread"

config PKGS_DIR
    string
    option env="PKGS_ROOT"
    default "../../../tools/packages"

# bsp
menu "Nextpilot Hardware Config"
orsource "*/Kconfig"
endmenu

# apps
orsource "../../../*/Kconfig"

# rthread
#source "$RTT_DIR/Kconfig"

# online package
#source "$PKGS_DIR/Kconfig"
```

## pkgs/cpuload/Kconfig
```kconfig
menuconfig PKG_USING_CPULOAD
    bool "cpuload: Measurement of CPU load of each individual task"
    default n
```

## pkgs/events/Kconfig
```kconfig
menuconfig PKG_USING_EVENTS
    bool "events: a protocol to send events based on an ID to inform other components"
    default n
```

## pkgs/hrtimer/Kconfig
```kconfig
menuconfig PKG_USING_HRTIMER
    bool "hrtimer: high-resolution timer with callouts and timekeeping"
    default n

if PKG_USING_HRTIMER
    choice
        prompt "Select Hrtimer Version"
        default PKG_USING_HRTIMER_V3

        config PKG_USING_HRTIMER_V1
            bool "PKG_USING_HRTIMER_V1"

        config PKG_USING_HRTIMER_V2
            bool "PKG_USING_HRTIMER_V2"

        config PKG_USING_HRTIMER_V3
            bool "PKG_USING_HRTIMER_V3"
    endchoice

    if PKG_USING_HRTIMER_V1
        rsource "V1/Kconfig"
    endif

    if PKG_USING_HRTIMER_V2
        rsource "V2/Kconfig"
    endif

    if PKG_USING_HRTIMER_V3
        rsource "V3/Kconfig"
    endif
endif
```

## pkgs/hrtimer/V1/Kconfig
```kconfig
if PKG_USING_HRTIMER_V1
    config HRT_USING_CALLOUT
        bool "Using callout function"
        default n
endif
```

## pkgs/hrtimer/V2/Kconfig
```kconfig
if PKG_USING_HRTIMER_V2
    choice
        prompt "Select hrtimer source"
        default HRT_USING_SYSTICK

        config HRT_USING_SYSTICK
            bool "sys tick"

        config HRT_USING_HWTIMER
            bool "hard timer"

    endchoice

    if HRT_USING_HWTIMER
        config HRT_HWTIMER_NAME
            string "hard timer name"
            default "tim13"
    endif

endif
```

## pkgs/hrtimer/V3/Kconfig
```kconfig
if PKG_USING_HRTIMER_V3

    choice
        prompt "Select boottime source"

        default HRT_USING_OSTICK

        config HRT_USING_OSTICK
            bool "os tick, 1ms"

        config HRT_USING_SYSTICK
            bool "sys tick, 1us"

        config HRT_USING_TIM
            bool "hard timer, 1us"

        config HRT_USING_DWT
            bool "DWT: Data Watchpoint and Trace, 1us"

        config HRT_USING_TSG
            bool "TSG: Global Timestamp Generator(STM32H7), 1us"

        config HRT_USING_RTC
            bool "RTC: Real Time Clock, 1s"

    endchoice

    choice
        prompt "select callout timer"

        default HRT_USING_OSTIMER

        config HRT_USING_OSTIMER
            bool "os soft timer, period 1ms"

        config HRT_USING_HWTIMER
            bool "pwm hard timer, period 65ms + dynamic"

    endchoice

endif
```

## pkgs/lib/avoidance/Kconfig
```kconfig
menuconfig PKG_USING_AVOIDANCE
    bool "avoidance: inject the setpoints of an obstacle avoidance system"
    select PKG_USING_MATRIX
    select PKG_USING_MATHLIB
    select PKG_USING_UORB
    select PKG_USING_BEZIER

    default n
```

## pkgs/lib/button/Kconfig
```kconfig
menuconfig PKG_USING_BUTTON_PUBLISHER
	bool "Library for button functionality"
	default n
```

## pkgs/lib/circuit_breaker/Kconfig
```kconfig
menuconfig PKG_USING_CIRCUIT_BREAKER
	bool "Circuit breaker functionality"
	default n
```

## pkgs/lib/collision_prevention/Kconfig
```kconfig
menuconfig PKG_USING_COLLISION_PREVENTION
    bool "collision: a CollisionPrevention controller"
    select PKG_USING_MATRIX
    select PKG_USING_MATHLIB
    select PKUG_USING_UORB

    default n
```

## pkgs/lib/console_buffer/Kconfig
```kconfig
menuconfig PKG_USING_CONSOLE_BUFFER
	bool "console_buffer: a simple console buffer to store the full bootup output"
	default n
```

## pkgs/lib/containers/Kconfig
```kconfig
config PKG_USING_CONTAINER
    bool "container : instrusive list and queue, array, bitset etc"
    default n
```

## pkgs/lib/geo/Kconfig
```kconfig
menuconfig PKG_USING_GEO
    bool "geo: geo / math functions to perform geodesic calculations"
    select PKG_USING_MATRIX
    select PKG_USING_MATHLIB
    select PKG_USING_HRTIMER
    default n
```
